/*
  FormGuard — TinyML squat-compensation classifier on ESP32 (Wokwi simulation)

  WHAT CHANGED FROM YOUR ORIGINAL SKETCH
  ----------------------------------------------------------------------------
  - Your original code flagged bad form with a fixed threshold:
        if (spinalFlexion > baselineFlexionMax) { ... }
    That's a rule, not a trained model.
  - This version trains a tiny neural net (offline, in Python, see
    generate_and_train.py) on a synthetic dataset of squat reps, converts it
    to TensorFlow Lite, and runs REAL on-device inference on the ESP32 at
    the end of every rep. The model looks at 4 features from the rep
    (thighAngleMax, backAngleMax, spinalFlexionMax, ratio) and outputs a
    probability that the rep was a "back-compensated" rep.
  - Everything else (calibration phase, rep detection, OLED, haptic motor,
    demo data playback) is unchanged from your sketch.

  LIBRARY REQUIRED (Wokwi Library Manager -> search, then add):
      TensorFlowLite_ESP32   (by TANAKA Masayuki)

  FILES YOU NEED IN THE SAME WOKWI PROJECT:
      FormGuard_TinyML.ino   (this file)
      model_data.h           (generated by generate_and_train.py)
*/
#include <Arduino.h>
#include <Wire.h>
#include <Adafruit_MPU6050.h>
#include <Adafruit_Sensor.h>
#include <Adafruit_SSD1306.h>

#include <TensorFlowLite_ESP32.h>
#include "tensorflow/lite/micro/micro_mutable_op_resolver.h"
#include "tensorflow/lite/micro/micro_error_reporter.h"
#include "tensorflow/lite/micro/micro_interpreter.h"
#include "tensorflow/lite/schema/schema_generated.h"
#include <TensorFlowLite_ESP32.h>

#include "modeldata.h"   // g_formguard_model[], g_feature_mean[], g_feature_std[]

#define SCREEN_WIDTH 128
#define SCREEN_HEIGHT 64
#define HAPTIC_PIN 12

// Enable DEMO_MODE to play back pre-recorded squat data
#define DEMO_MODE false

void updateOLED(String line1, String line2);
void runCalibrationPhase(float thighAngle, float backAngle, float spinalFlexion);
void runFormAnalysisPhase(float thighAngle, float backAngle, float spinalFlexion);

Adafruit_SSD1306 display(SCREEN_WIDTH, SCREEN_HEIGHT, &Wire, -1);
Adafruit_MPU6050 mpuWrist;
Adafruit_MPU6050 mpuBack;

// ---------------------------------------------------------------------------
// TensorFlow Lite Micro globals
// ---------------------------------------------------------------------------
namespace {
tflite::ErrorReporter* error_reporter = nullptr;
const tflite::Model* tflModel = nullptr;
tflite::MicroInterpreter* interpreter = nullptr;
TfLiteTensor* modelInput = nullptr;
TfLiteTensor* modelOutput = nullptr;

constexpr int kTensorArenaSize = 4 * 1024;
uint8_t tensor_arena[kTensorArenaSize];
}  // namespace

void setupModel() {
  static tflite::MicroErrorReporter micro_error_reporter;
  error_reporter = &micro_error_reporter;

  tflModel = tflite::GetModel(g_formguard_model);
  if (tflModel->version() != TFLITE_SCHEMA_VERSION) {
    error_reporter->Report(
        "Model schema version %d != supported version %d",
        tflModel->version(), TFLITE_SCHEMA_VERSION);
    while (1) { delay(1000); }
  }

  static tflite::MicroMutableOpResolver<2> resolver;
  resolver.AddFullyConnected();
  resolver.AddLogistic();

  static tflite::MicroInterpreter static_interpreter(
      tflModel, resolver, tensor_arena, kTensorArenaSize, error_reporter);
  interpreter = &static_interpreter;

  TfLiteStatus allocate_status = interpreter->AllocateTensors();
  if (allocate_status != kTfLiteOk) {
    error_reporter->Report("AllocateTensors() failed");
    while (1) { delay(1000); }
  }

  modelInput = interpreter->input(0);
  modelOutput = interpreter->output(0);
}

// Returns probability (0..1) that this rep was back-compensated.
float classifyRep(float thighAngleMax, float backAngleMax,
                   float spinalFlexionMax, float ratio) {
  float raw[4] = {thighAngleMax, backAngleMax, spinalFlexionMax, ratio};
  for (int i = 0; i < 4; i++) {
    modelInput->data.f[i] = (raw[i] - g_feature_mean[i]) / g_feature_std[i];
  }

  if (interpreter->Invoke() != kTfLiteOk) {
    error_reporter->Report("Invoke() failed");
    return 0.0f;
  }

  return modelOutput->data.f[0];
}

// ---------------------------------------------------------------------------
// Pipeline states (unchanged)
// ---------------------------------------------------------------------------
enum SystemState { CALIBRATING, MONITORING };
SystemState currentState = CALIBRATING;

int calibReps = 0;
float baselineFlexionMax = 0.0;
float flexSum = 0.0;

int totalReps = 0;
int badFormReps = 0;
bool repInProgress = false;
float maxFlexionInRep = 0.0;
float maxThighInRep = 0.0;
float maxBackInRep = 0.0;

float initialFormScore = 0.0;
float fatigueDegradationPct = 0.0;
float lastBadFormProb = 0.0;

const int DEMO_SAMPLES = 25;
float demoData[DEMO_SAMPLES][2] = {
  {5.0, 2.0},   {25.0, 8.0},  {55.0, 15.0}, {20.0, 6.0},  {0.0, 0.0},  // Rep 1 (Good)
  {6.0, 2.0},   {30.0, 9.0},  {60.0, 16.0}, {15.0, 4.0},  {0.0, 0.0},  // Rep 2 (Good)
  {4.0, 1.0},   {28.0, 8.0},  {58.0, 14.0}, {18.0, 5.0},  {0.0, 0.0},  // Rep 3 (Good)
  {5.0, 2.0},   {32.0, 35.0}, {62.0, 52.0}, {22.0, 25.0}, {0.0, 0.0},  // Rep 4 (Back Compensation)
  {6.0, 3.0},   {35.0, 42.0}, {65.0, 60.0}, {25.0, 30.0}, {0.0, 0.0}   // Rep 5 (Severe Fatigue)
};
int demoIndex = 0;

void setup() {
  Serial.begin(115200);
  pinMode(HAPTIC_PIN, OUTPUT);
  digitalWrite(HAPTIC_PIN, LOW);

  Wire.begin(21, 22);

  if (!display.begin(SSD1306_SWITCHCAPVCC, 0x3C)) {
    Serial.println("OLED allocation failed");
  }
  display.clearDisplay();
  display.setTextColor(WHITE);
  display.setTextSize(1);

  if (!DEMO_MODE) {
    mpuWrist.begin(0x68);
    mpuBack.begin(0x69);
    mpuWrist.setAccelerometerRange(MPU6050_RANGE_8_G);
    mpuBack.setAccelerometerRange(MPU6050_RANGE_8_G);
  }

  setupModel();

  updateOLED("FormGuard Ready", "Calibrating Base...");
  delay(1500);
}

void loop() {
  float thighAngle = 0.0;
  float backAngle = 0.0;

  if (DEMO_MODE) {
    thighAngle = demoData[demoIndex][0];
    backAngle = demoData[demoIndex][1];
    demoIndex = (demoIndex + 1) % DEMO_SAMPLES;
  } else {
    sensors_event_t aW, gW, tW, aB, gB, tB;
    mpuWrist.getEvent(&aW, &gW, &tW);
    mpuBack.getEvent(&aB, &gB, &tB);
    thighAngle = atan2(aW.acceleration.y, aW.acceleration.z) * 180.0 / M_PI;
    backAngle = atan2(aB.acceleration.y, aB.acceleration.z) * 180.0 / M_PI;
  }

  float spinalFlexion = abs(backAngle - (thighAngle * 0.45));

  if (currentState == CALIBRATING) {
    runCalibrationPhase(thighAngle, backAngle, spinalFlexion);
  } else {
    runFormAnalysisPhase(thighAngle, backAngle, spinalFlexion);
  }

  delay(200);
}

void runCalibrationPhase(float thighAngle, float backAngle, float spinalFlexion) {
  if (thighAngle > 20.0 && !repInProgress) {
    repInProgress = true;
    maxFlexionInRep = 0.0;
  }

  if (repInProgress) {
    if (spinalFlexion > maxFlexionInRep) maxFlexionInRep = spinalFlexion;

    if (thighAngle < 10.0) {
      repInProgress = false;
      calibReps++;
      flexSum += maxFlexionInRep;

      updateOLED("Calibrating...", "Rep " + String(calibReps) + "/3 Done");

      if (calibReps >= 3) {
        baselineFlexionMax = (flexSum / 3.0) * 1.20;
        initialFormScore = flexSum / 3.0;
        currentState = MONITORING;
        updateOLED("Calib Complete!", "Baseline: " + String(baselineFlexionMax, 1) + " deg");
        delay(1500);
      }
    }
  }
}

void runFormAnalysisPhase(float thighAngle, float backAngle, float spinalFlexion) {
  if (thighAngle > 20.0 && !repInProgress) {
    repInProgress = true;
    maxFlexionInRep = 0.0;
    maxThighInRep = 0.0;
    maxBackInRep = 0.0;
  }

  if (repInProgress) {
    if (spinalFlexion > maxFlexionInRep) maxFlexionInRep = spinalFlexion;
    if (thighAngle > maxThighInRep) maxThighInRep = thighAngle;
    if (backAngle > maxBackInRep) maxBackInRep = backAngle;

    if (thighAngle < 10.0) {
      repInProgress = false;
      totalReps++;

      float ratio = (maxThighInRep > 1.0) ? (maxBackInRep / maxThighInRep) : 0.0;

      // --- On-device TinyML inference replaces the fixed threshold check ---
      lastBadFormProb = classifyRep(maxThighInRep, maxBackInRep,
                                     maxFlexionInRep, ratio);
      bool badForm = lastBadFormProb > 0.5;

      if (badForm) {
        badFormReps++;
        digitalWrite(HAPTIC_PIN, HIGH);
      } else {
        digitalWrite(HAPTIC_PIN, LOW);
      }

      fatigueDegradationPct = ((maxFlexionInRep - initialFormScore) / initialFormScore) * 100.0;
      if (fatigueDegradationPct < 0) fatigueDegradationPct = 0;

      Serial.print("Rep:"); Serial.print(totalReps);
      Serial.print(" | Flexion:"); Serial.print(maxFlexionInRep);
      Serial.print(" | BadFormProb:"); Serial.print(lastBadFormProb, 3);
      Serial.print(" | Degradation:"); Serial.print(fatigueDegradationPct);
      Serial.println("%");
    }
  }

  display.clearDisplay();
  display.setCursor(0, 0);
  display.print("Reps: "); display.print(totalReps);
  display.print(" (Bad: "); display.print(badFormReps); display.println(")");
  display.print("Flexion: "); display.print(spinalFlexion, 1); display.println(" deg");
  display.print("BadFormProb: "); display.print(lastBadFormProb * 100.0, 0); display.println("%");
  display.print("Fatigue Deg: +"); display.print(fatigueDegradationPct, 0); display.println("%");

  if (lastBadFormProb > 0.5) {
    display.println("!! COMPENSATING !!");
  }
  display.display();
}

void updateOLED(String line1, String line2) {
  display.clearDisplay();
  display.setCursor(0, 10);
  display.println(line1);
  display.println(line2);
  display.display();
}